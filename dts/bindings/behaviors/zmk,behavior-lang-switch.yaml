## dts/bindings/behaviors/zmk,behavior-lang-switch.yaml
```yaml
# Copyright (c) 2024 The ZMK Contributors
# SPDX-License-Identifier: MIT

description: Language switch behavior

compatible: "zmk,behavior-lang-switch"

include: one_param.yaml

properties:
  bindings:
    type: phandle-array
    required: true
    description: First binding is for English keycode, second for Russian keycode
  en_layer:
    type: int
    required: true
    description: Layer number for English layout
  ru_layer:
    type: int
    required: true
    description: Layer number for Russian layout
```

## dts/bindings/behaviors/zmk,behavior-modifier-press.yaml
```yaml
description: Press-on-modifier behavior for counter functionality

compatible: "zmk,behavior-modifier-press"

include: one_param.yaml
```
